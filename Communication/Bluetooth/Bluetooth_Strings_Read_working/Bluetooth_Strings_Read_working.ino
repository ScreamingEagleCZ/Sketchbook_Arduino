/*        
       Working communication over Bluetooth
       by Jakub Mukařovský
*/
#include <SoftwareSerial.h>

SoftwareSerial Bluetooth(10, 11); // Arduino(RX, TX) - HC-05 also HC-06 Bluetooth (TX, RX)
// Software serial doesnt work with HW RX,TX of Mega (14,15,16,17,18,19,20,21) use normal digital pins instead
String dataIn = "";

void setup() {
  Serial.begin(9600);
  Serial.println("Bluetooth String test");

   delay(10); 
 
  Bluetooth.begin(9600); // Default baud rate of the Bluetooth module HC-06
  Bluetooth.setTimeout(10); //if too low (like 1ms), the arduino only reads like only first 3 chars of string, then other 3, and other...
  delay(20);
}

void loop() {
  // Check for incoming data
  if (Bluetooth.available() > 0) {
    dataIn = Bluetooth.readString();  // Read the data as string
    Serial.println(dataIn);
    Bluetooth.println(dataIn);
    
    
    
    
    
    // If "Waist" slider has changed value - Move Servo 1 to position
    if (dataIn.startsWith("s1")) {
      String dataInS = dataIn.substring(2, dataIn.length()); // Extract only the number. E.g. from "s1120" to "120"
      Serial.println("S1 " + dataInS);
      Bluetooth.println("S1 " + dataInS);
    }
    
    // Move Servo 2
    if (dataIn.startsWith("s2")) {
      String dataInS = dataIn.substring(2, dataIn.length());
      
      Serial.println("S2 " + dataInS);
      Bluetooth.println("S2 " + dataInS);
    }
    // Move Servo 3
    if (dataIn.startsWith("s3")) {
      String dataInS = dataIn.substring(2, dataIn.length());
      Serial.println("S3 " + dataInS);
      Bluetooth.println("S3 " + dataInS);
    }
    // Move Servo 4
    if (dataIn.startsWith("s4")) {
      String dataInS = dataIn.substring(2, dataIn.length());
      Serial.println("S4 " + dataInS);
      Bluetooth.println("S4 " + dataInS);
    }
    // Move Servo 5
    if (dataIn.startsWith("s5")) {
      String dataInS = dataIn.substring(2, dataIn.length());
      Serial.println("S5 " + dataInS);
      Bluetooth.println("S5 " + dataInS);
    }
    // Move Servo 6
    if (dataIn.startsWith("s6")) {
      String dataInS = dataIn.substring(2, dataIn.length());
      Serial.println("S6 " + dataInS);
      Bluetooth.println("S6 " + dataInS);
    }
    // If button "SAVE" is pressed
    if (dataIn.startsWith("SAVE")) {
      Serial.println("Saving... ");
      Bluetooth.println("Saving...");
    }
    // If button "RUN" is pressed
    if (dataIn.startsWith("RUN")) {
      Serial.println("Running...");
      Bluetooth.println("Running..." ); 
    }
    // If button "RESET" is pressed
    if ( dataIn == "RESET") {
      Serial.println("Reseting... ");
      Bluetooth.println("Reseting...");
    }
  }
}

